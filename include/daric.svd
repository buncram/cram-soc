# daric register map
Vendor: cramium
Registers are 32-bit, read-write, reset 0x0 unless marked. A register's access mark holds for its fields unless they carry their own. Offsets are from the block's base; [hi:lo] are bit positions; {n}, {i} and the like mark numbered series.

## SCEDMA
Base 0x40029000
0x00 SFR_SCHSTART_AR — See file:///F:/code/cram-soc/soc_oss/rtl/crypto/scedma_v0.1.sv
  [31:0] sfr_schstart_ar — sfr_schstart_ar performs action on write of value: 0xaa
0x10 SFR_XCH_FUNC — See file:///F:/code/cram-soc/soc_oss/rtl/crypto/scedma_v0.1.sv
  [0] sfr_xch_func — sfr_xch_func read/write control register
0x14 SFR_XCH_OPT — See file:///F:/code/cram-soc/soc_oss/rtl/crypto/scedma_v0.1.sv
  [7:0] sfr_xch_opt — sfr_xch_opt read/write control register
0x18 SFR_XCH_AXSTART — See file:///F:/code/cram-soc/soc_oss/rtl/crypto/scedma_v0.1.sv
  [31:0] sfr_xch_axstart — sfr_xch_axstart read/write control register
0x1C SFR_XCH_SEGID — See file:///F:/code/cram-soc/soc_oss/rtl/crypto/scedma_v0.1.sv
  [7:0] sfr_xch_segid — sfr_xch_segid read/write control register
0x20 SFR_XCH_SEGSTART — See file:///F:/code/cram-soc/soc_oss/rtl/crypto/scedma_v0.1.sv
  [11:0] xchcr_segstart — xchcr_segstart read/write control register
0x24 SFR_XCH_TRANSIZE — See file:///F:/code/cram-soc/soc_oss/rtl/crypto/scedma_v0.1.sv
  [29:0] xchcr_transize — xchcr_transize read/write control register
0x30 SFR_SCH_FUNC — See file:///F:/code/cram-soc/soc_oss/rtl/crypto/scedma_v0.1.sv
  [0] sfr_sch_func — sfr_sch_func read/write control register
0x34 SFR_SCH_OPT — See file:///F:/code/cram-soc/soc_oss/rtl/crypto/scedma_v0.1.sv
  [7:0] sfr_sch_opt — sfr_sch_opt read/write control register
0x38 SFR_SCH_AXSTART — See file:///F:/code/cram-soc/soc_oss/rtl/crypto/scedma_v0.1.sv
  [31:0] sfr_sch_axstart — sfr_sch_axstart read/write control register
0x3C SFR_SCH_SEGID — See file:///F:/code/cram-soc/soc_oss/rtl/crypto/scedma_v0.1.sv
  [7:0] sfr_sch_segid — sfr_sch_segid read/write control register
0x40 SFR_SCH_SEGSTART — See file:///F:/code/cram-soc/soc_oss/rtl/crypto/scedma_v0.1.sv
  [11:0] schcr_segstart — schcr_segstart read/write control register
0x44 SFR_SCH_TRANSIZE — See file:///F:/code/cram-soc/soc_oss/rtl/crypto/scedma_v0.1.sv
  [29:0] schcr_transize — schcr_transize read/write control register
0x50 SFR_ICH_OPT — See file:///F:/code/cram-soc/soc_oss/rtl/crypto/scedma_v0.1.sv
  [3:0] sfr_ich_opt — sfr_ich_opt read/write control register
0x54 SFR_ICH_SEGID — See file:///F:/code/cram-soc/soc_oss/rtl/crypto/scedma_v0.1.sv
  [15:0] sfr_ich_segid — sfr_ich_segid read/write control register
0x58 SFR_ICH_RPSTART — See file:///F:/code/cram-soc/soc_oss/rtl/crypto/scedma_v0.1.sv
  [11:0] ichcr_rpstart — ichcr_rpstart read/write control register
0x5C SFR_ICH_WPSTART — See file:///F:/code/cram-soc/soc_oss/rtl/crypto/scedma_v0.1.sv
  [11:0] ichcr_wpstart — ichcr_wpstart read/write control register
0x60 SFR_ICH_TRANSIZE — See file:///F:/code/cram-soc/soc_oss/rtl/crypto/scedma_v0.1.sv
  [11:0] ichcr_transize — ichcr_transize read/write control register

## SCE_GLBSFR
Base 0x40028000
0x00 SFR_SCEMODE — See file:///F:/code/cram-soc/soc_oss/rtl/crypto/sce_glbsfr_v0.1.sv
  [1:0] cr_scemode — cr_scemode read/write control register
0x04 SFR_SUBEN — See file:///F:/code/cram-soc/soc_oss/rtl/crypto/sce_glbsfr_v0.1.sv
  [15:0] cr_suben — cr_suben read/write control register
0x08 SFR_AHBS — See file:///F:/code/cram-soc/soc_oss/rtl/crypto/sce_glbsfr_v0.1.sv
  [4:0] cr_ahbsopt — cr_ahbsopt read/write control register
0x10 SFR_SRBUSY — See file:///F:/code/cram-soc/soc_oss/rtl/crypto/sce_glbsfr_v0.1.sv
  [15:0] sr_busy — sr_busy read only status register
0x14 SFR_FRDONE — See file:///F:/code/cram-soc/soc_oss/rtl/crypto/sce_glbsfr_v0.1.sv
  [15:0] fr_done — fr_done flag register. `1` means event happened, write back `1` in respective bit position to clear the flag
0x18 SFR_FRERR — See file:///F:/code/cram-soc/soc_oss/rtl/crypto/sce_glbsfr_v0.1.sv
  [15:0] fr_err — fr_err flag register. `1` means event happened, write back `1` in respective bit position to clear the flag
0x1C SFR_ARCLR — See file:///F:/code/cram-soc/soc_oss/rtl/crypto/sce_glbsfr_v0.1.sv
  [31:0] ar_clrram — ar_clrram performs action on write of value: 0xa5
0x20 SFR_FRACERR — See file:///F:/code/cram-soc/soc_oss/rtl/crypto/sce_glbsfr_v0.1.sv
  [7:0] fr_acerr — fr_acerr flag register. `1` means event happened, write back `1` in respective bit position to clear the flag
0x24 SFR_TICKCNT — See file:///F:/code/cram-soc/soc_oss/rtl/crypto/sce_glbsfr_v0.1.sv
  [31:0] sfr_tickcnt — sfr_tickcnt read only status register
0x30 SFR_FFEN — See file:///F:/code/cram-soc/soc_oss/rtl/crypto/sce_glbsfr_v0.1.sv
  [5:0] cr_ffen — cr_ffen read/write control register
0x34 SFR_FFCLR — See file:///F:/code/cram-soc/soc_oss/rtl/crypto/sce_glbsfr_v0.1.sv
  [31:0] ar_ffclr — ar_ffclr performs action on write of value: (32'hff00+i)
{0x40+4i} SFR_FFCNT_SR_FF{i} (i=0..5) — See file:///F:/code/cram-soc/soc_oss/rtl/crypto/sce_glbsfr_v0.1.sv
  [15:0] sr_ff{i} — sr_ff read only status register
0xFC SFR_TS — See file:///F:/code/cram-soc/soc_oss/rtl/crypto/sce_glbsfr_v0.1.sv
  [15:0] cr_ts — cr_ts read/write control register
