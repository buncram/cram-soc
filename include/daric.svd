# daric register map
Vendor: cramium
Registers are 32-bit, read-write, reset 0x0 unless marked. A register's access mark holds for its fields unless they carry their own. Offsets are from the block's base; [hi:lo] are bit positions; {n}, {i} and the like mark numbered series.

## TRNG
Base 0x4002E000
0x00 SFR_CRSRC — See file:///F:/code/cram-soc/soc_oss/rtl/crypto/trng_v0.2.sv
  [11:0] sfr_crsrc — sfr_crsrc read/write control register
0x04 SFR_CRANA — See file:///F:/code/cram-soc/soc_oss/rtl/crypto/trng_v0.2.sv
  [15:0] sfr_crana — sfr_crana read/write control register
0x08 SFR_PP — See file:///F:/code/cram-soc/soc_oss/rtl/crypto/trng_v0.2.sv
  [16:0] sfr_pp — sfr_pp read/write control register
0x0C SFR_OPT — See file:///F:/code/cram-soc/soc_oss/rtl/crypto/trng_v0.2.sv
  [16:0] sfr_opt — sfr_opt read/write control register
0x10 SFR_SR — See file:///F:/code/cram-soc/soc_oss/rtl/crypto/trng_v0.2.sv
  [31:0] sr_rng — sr_rng read only status register
0x14 SFR_AR_GEN — See file:///F:/code/cram-soc/soc_oss/rtl/crypto/trng_v0.2.sv
  [31:0] sfr_ar_gen — sfr_ar_gen performs action on write of value: 0x55
0x18 SFR_FR — See file:///F:/code/cram-soc/soc_oss/rtl/crypto/trng_v0.2.sv
  [1:0] sfr_fr — sfr_fr flag register. `1` means event happened, write back `1` in respective bit position to clear the flag
0x20 SFR_DRPSZ — See file:///F:/code/cram-soc/soc_oss/rtl/crypto/trng_v0.2.sv
  [31:0] sfr_drpsz — sfr_drpsz read/write control register
0x24 SFR_DRGEN — See file:///F:/code/cram-soc/soc_oss/rtl/crypto/trng_v0.2.sv
  [31:0] sfr_drgen — sfr_drgen read/write control register
0x28 SFR_DRRESEED — See file:///F:/code/cram-soc/soc_oss/rtl/crypto/trng_v0.2.sv
  [31:0] sfr_drreseed — sfr_drreseed read/write control register
0x30 SFR_BUF — See file:///F:/code/cram-soc/soc_oss/rtl/crypto/trng_v0.2.sv
  [31:0] sfr_buf — sfr_buf read only status register
0x40 SFR_CHAIN_RNGCHAINEN0 — See file:///F:/code/cram-soc/soc_oss/rtl/crypto/trng_v0.2.sv
  [31:0] rngchainen0 — sfr_chain read/write control register
0x44 SFR_CHAIN_RNGCHAINEN1 — See file:///F:/code/cram-soc/soc_oss/rtl/crypto/trng_v0.2.sv
  [31:0] rngchainen1 — sfr_chain read/write control register

## DUART
Base 0x40042000
0x00 SFR_TXD — See file:///F:/code/cram-soc/soc_oss/rtl/core/duart_v0.1.sv
  [7:0] sfr_txd — sfr_txd read/write control register
0x04 SFR_CR — See file:///F:/code/cram-soc/soc_oss/rtl/core/duart_v0.1.sv
  [0] sfr_cr — sfr_cr read/write control register
0x08 SFR_SR — See file:///F:/code/cram-soc/soc_oss/rtl/core/duart_v0.1.sv
  [0] sfr_sr — sfr_sr read only status register
0x0C SFR_ETUC — See file:///F:/code/cram-soc/soc_oss/rtl/core/duart_v0.1.sv
  [15:0] sfr_etuc — sfr_etuc read/write control register

## EVC
Base 0x40044000
{0x0+4i} SFR_CM7EVSEL_CM7EVSEL{i} (i=0..7) — See file:///F:/code/cram-soc/soc_oss/rtl/sysctrl/evc_v0.1.sv
  [7:0] cm7evsel{i} — cm7evsel read/write control register
0x20 SFR_CM7EVEN — See file:///F:/code/cram-soc/soc_oss/rtl/sysctrl/evc_v0.1.sv
  [7:0] cm7even — cm7even read/write control register
0x24 SFR_CM7EVFR — See file:///F:/code/cram-soc/soc_oss/rtl/sysctrl/evc_v0.1.sv
  [7:0] cm7evs — cm7evs flag register. `1` means event happened, write back `1` in respective bit position to clear the flag
0x30 SFR_TMREVSEL — See file:///F:/code/cram-soc/soc_oss/rtl/sysctrl/evc_v0.1.sv
  [15:0] tmr_evsel — tmr_evsel read/write control register
0x34 SFR_PWMEVSEL — See file:///F:/code/cram-soc/soc_oss/rtl/sysctrl/evc_v0.1.sv
  [31:0] pwm_evsel — pwm_evsel read/write control register
{0x40+4i} SFR_IFEVEN_IFEVEN{i} (i=0..7) — See file:///F:/code/cram-soc/soc_oss/rtl/sysctrl/evc_v0.1.sv
  [31:0] ifeven{i} — ifeven read/write control register
0x60 SFR_IFEVERRFR — See file:///F:/code/cram-soc/soc_oss/rtl/sysctrl/evc_v0.1.sv
  [31:0] ifev_errs — ifev_errs flag register. `1` means event happened, write back `1` in respective bit position to clear the flag
0x80 SFR_CM7ERRFR — See file:///F:/code/cram-soc/soc_oss/rtl/sysctrl/evc_v0.1.sv
  [31:0] errin — errin flag register. `1` means event happened, write back `1` in respective bit position to clear the flag
